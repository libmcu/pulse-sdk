## CMakeLists.txt
```
cmake_minimum_required(VERSION 3.20)
find_package(Zephyr REQUIRED HINTS $ENV{ZEPHYR_BASE})
project(pulse-example-zephyr)

target_include_directories(app PRIVATE include)
target_sources(app PRIVATE src/main.c)
```

## west.yml
```
manifest:
  projects:
    # Full example workspace manifest.
    # The README only shows the pulse stanza users add to an existing
    # manifest, but this example must also fetch Zephyr itself.
    - name: zephyr
      url: https://github.com/zephyrproject-rtos/zephyr.git
      revision: v4.4.0
      import: true
    - name: pulse
      url: https://github.com/libmcu/pulse-sdk.git
      path: modules/lib/pulse
      revision: main

  self:
    path: app
```

## prj.conf
```kconfig
CONFIG_PULSE=y

CONFIG_NETWORKING=y
CONFIG_NET_IPV4=y
CONFIG_NET_TCP=y
CONFIG_NET_SOCKETS=y
CONFIG_DNS_RESOLVER=y

CONFIG_HTTP_CLIENT=y

CONFIG_NET_SOCKETS_SOCKOPT_TLS=y
CONFIG_TLS_CREDENTIALS=y
CONFIG_MBEDTLS=y
CONFIG_MBEDTLS_BUILTIN=y
CONFIG_MBEDTLS_ENABLE_HEAP=y
CONFIG_MBEDTLS_HEAP_SIZE=60000
CONFIG_MBEDTLS_PSA_CRYPTO_C=y
CONFIG_PSA_CRYPTO=y
CONFIG_MBEDTLS_SSL_PROTO_TLS1_2=y
CONFIG_MBEDTLS_CIPHERSUITE_TLS_ECDHE_ECDSA_WITH_AES_128_GCM_SHA256=y
CONFIG_MBEDTLS_CIPHERSUITE_TLS_ECDHE_RSA_WITH_AES_128_GCM_SHA256=y
```

## prj_coaps.conf
```kconfig
CONFIG_PULSE_TRANSPORT_COAPS=y
CONFIG_PULSE_TRANSPORT_HTTPS=n
```

## prj_https.conf
```kconfig
CONFIG_PULSE_TRANSPORT_HTTPS=y
CONFIG_PULSE_TRANSPORT_COAPS=n
```

## boards/native_sim.conf
```kconfig
CONFIG_ENTROPY_GENERATOR=y
CONFIG_FAKE_ENTROPY_NATIVE_SIM=y
```

## src/main.c
```c
/*
 * SPDX-FileCopyrightText: 2026 권경환 Kyunghwan Kwon <k@libmcu.org>
 *
 * SPDX-License-Identifier: MIT
 */

#include "pulse/pulse.h"

int main(void)
{
	struct pulse conf = {
		.token = "example-token",
		.serial_number = "zephyr-device-1",
		.software_version = "1.0.0",
	};
	pulse_init(&conf);
	pulse_report();
	return 0;
}
```
