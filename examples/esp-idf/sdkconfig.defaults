## examples/esp-idf/sdkconfig.defaults
```kconfig
CONFIG_COAP_CLIENT_SUPPORT=y
# CONFIG_COAP_SERVER_SUPPORT is not set
CONFIG_MBEDTLS_SSL_PROTO_DTLS=y
```

## ports/esp-idf/Kconfig
```kconfig
# SPDX-License-Identifier: MIT

menu "Pulse"

choice PULSE_TRANSPORT
	prompt "Transport protocol"
	default PULSE_TRANSPORT_COAPS
	help
	  Select the transport used to send metrics to the ingest server.

config PULSE_TRANSPORT_COAPS
	bool "CoAPS (CoAP over DTLS PSK)"
	select COAP_CLIENT_SUPPORT
	select MBEDTLS_SSL_PROTO_DTLS
	select MBEDTLS_PSK_MODES
	select MBEDTLS_KEY_EXCHANGE_PSK
	help
	  Send metrics over CoAP with DTLS PSK authentication.
	  The authentication token supplied to pulse_init() is used as the PSK.

config PULSE_TRANSPORT_HTTPS
	bool "HTTPS"
	help
	  Send metrics over HTTPS over TLS.

endchoice

config PULSE_LIBMCU
	bool "Enable additional libmcu modules"
	default n
	help
	  Build and expose additional libmcu modules (retry, ratelim, etc.)
	  beyond the metrics modules that Pulse requires internally.

config PULSE_CBOR
	bool "Enable cbor API access"
	default n
	help
	  Expose the cbor library headers so the application can use
	  cbor encoding/decoding directly.

endmenu
```

## zephyr/Kconfig
```kconfig
# SPDX-License-Identifier: MIT

menuconfig PULSE
	bool "pulse"
	default y
	help
	  Pulse module support.

choice PULSE_TRANSPORT
	prompt "Transport protocol"
	depends on PULSE
	default PULSE_TRANSPORT_COAPS
	help
	  Select the transport used to send metrics to the ingest server.

config PULSE_TRANSPORT_HTTPS
	bool "HTTPS"
	help
	  Send metrics over HTTPS (TLS over TCP).

config PULSE_TRANSPORT_COAPS
	bool "CoAPS (CoAP over DTLS PSK)"
	select COAP
	select MBEDTLS
	select MBEDTLS_PSA_CRYPTO_C
	select NET_SOCKETS_ENABLE_DTLS
	select MBEDTLS_KEY_EXCHANGE_PSK_ENABLED
	select PSA_CRYPTO
	help
	  Send metrics over CoAP with DTLS PSK authentication.
	  The authentication token supplied to pulse_init() is used as the PSK.
	  Requires CONFIG_MBEDTLS_CIPHER_GCM_ENABLED or
	  CONFIG_MBEDTLS_CIPHER_CCM_ENABLED for cipher suite negotiation.

endchoice

config PULSE_LIBMCU
	bool "Enable additional libmcu modules"
	depends on PULSE
	help
	  Build and expose additional libmcu modules (retry, runner, etc.)
	  beyond the metrics and ratelim modules that Pulse requires internally.

config PULSE_CBOR
	bool "Enable cbor API access"
	depends on PULSE
	help
	  Expose the cbor library headers so the application can use
	  cbor encoding/decoding directly.

config PULSE_METRICS_USER_DEFINES
	string "User metrics definition file path"
	depends on PULSE
	default "include/metrics.def"
	help
	  Path to the user-supplied metrics definition file.
	  Set this to the path that should be passed as METRICS_USER_DEFINES.
	  The default follows the libmcu Zephyr integration convention.
```
